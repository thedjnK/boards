## arm/bt510_fridge/Kconfig.board
```kconfig
# BT510 DVK board configuration

# Copyright (c) 2020 Laird Connectivity
# SPDX-License-Identifier: Apache-2.0

config BOARD_BT510_FRIDGE
	bool "BT510 Fridge"
	depends on SOC_NRF52840_QIAA
```

## arm/bt510_fridge/dts/bindings/gpio-switch.yaml
```yaml
description: Switch (FET/transistor) output

compatible: "gpio-switch"

properties:
  gpios:
    type: phandle-array
    required: true
    description: |
      GPIO output
```

## bl5340_dvk_net/Kconfig.bl5340_dvk_net
```kconfig
# Copyright (c) 2024 thedjnK
# SPDX-License-Identifier: Apache-2.0

config BOARD_BL5340_DVK_NET
	select SOC_NRF5340_CPUAPP_QKAA if (BOARD_BL5340_DVK_NET_NRF5340_CPUAPP || BOARD_BL5340_DVK_NET_NRF5340_CPUAPP_NS)
	select SOC_NRF5340_CPUNET_QKAA if BOARD_BL5340_DVK_NET_NRF5340_CPUNET
```

## bl5340_dvk_net/board.yml
```yaml
board:
  name: bl5340_dvk_net
  full_name: BL5340 DVK for network loading
  vendor: thedjnK
  revision:
    format: number
    default: "1"
    revisions:
      - name: "1"
      - name: "0"
  socs:
    - name: nrf5340
      variants:
        - name: ns
          cpucluster: cpuapp
```

## bl54l15_breakout/Kconfig.bl54l15_breakout
```kconfig
# Copyright (c) 2024 Nordic Semiconductor ASA
# SPDX-License-Identifier: Apache-2.0

config BOARD_BL54L15_BREAKOUT
	select SOC_NRF54L15_CPUAPP if BOARD_BL54L15_BREAKOUT_NRF54L15_CPUAPP || \
				      BOARD_BL54L15_BREAKOUT_NRF54L15_CPUAPP_LORA
	select SOC_NRF54L15_CPUFLPR if BOARD_BL54L15_BREAKOUT_NRF54L15_CPUFLPR || \
				       BOARD_BL54L15_BREAKOUT_NRF54L15_CPUFLPR_XIP || \
				       BOARD_BL54L15_BREAKOUT_NRF54L15_CPUFLPR_LORA || \
				       BOARD_BL54L15_BREAKOUT_NRF54L15_CPUFLPR_LORA_XIP
```

## bl54l15_breakout/Kconfig.defconfig
```kconfig
#
# Copyright (c) 2025, Jamie M.
#
# All right reserved. This code is NOT apache or FOSS/copyleft licensed.
#

config ROM_START_OFFSET
	default 0x800 if BOOTLOADER_MCUBOOT && SOC_NRF54L15_CPUAPP
```

## bl54l15_breakout/board.yml
```yaml
board:
  name: bl54l15_breakout
  full_name: BL54L15 breakout board
  vendor: thedjnK
  socs:
    - name: nrf54l15
      variants:
        - name: xip
          cpucluster: cpuflpr
        - name: lora
          cpucluster: cpuapp
        - name: lora
          cpucluster: cpuflpr
          variants:
            - name: xip
runners:
  run_once:
    '--recover':
    - runners:
      - nrfutil
      run: first
      groups:
      - boards:
        - bl54l15_breakout/nrf54l15/cpuapp
        - bl54l15_breakout/nrf54l15/cpuflpr
        - bl54l15_breakout/nrf54l15/cpuflpr/xip
      - boards:
        - bl54l15_breakout/nrf54l15/cpuapp/lora
        - bl54l15_breakout/nrf54l15/cpuflpr/lora
        - bl54l15_breakout/nrf54l15/cpuflpr/lora/xip
    '--erase':
    - runners:
      - jlink
      - nrfutil
      run: first
      groups:
      - boards:
        - bl54l15_breakout/nrf54l15/cpuapp
        - bl54l15_breakout/nrf54l15/cpuflpr
        - bl54l15_breakout/nrf54l15/cpuflpr/xip
      - boards:
        - bl54l15_breakout/nrf54l15/cpuapp/lora
        - bl54l15_breakout/nrf54l15/cpuflpr/lora
        - bl54l15_breakout/nrf54l15/cpuflpr/lora/xip
    '--reset':
    - runners:
      - jlink
      - nrfutil
      run: last
      groups:
      - boards:
        - bl54l15_breakout/nrf54l15/cpuapp
        - bl54l15_breakout/nrf54l15/cpuflpr
        - bl54l15_breakout/nrf54l15/cpuflpr/xip
      - boards:
        - bl54l15_breakout/nrf54l15/cpuapp/lora
        - bl54l15_breakout/nrf54l15/cpuflpr/lora
        - bl54l15_breakout/nrf54l15/cpuflpr/lora/xip
```

## bl652_breakout/Kconfig
```kconfig
# Copyright (c) 2024 thedjnK
# SPDX-License-Identifier: Apache-2.0

config BOARD_ENABLE_DCDC
	bool "DCDC mode"
	default y
	select SOC_DCDC_NRF52X
	depends on BOARD_BL652_BREAKOUT
```

## bl652_breakout/Kconfig.bl652_breakout
```kconfig
# Copyright (c) 2024 thedjnK
# SPDX-License-Identifier: Apache-2.0

config BOARD_BL652_BREAKOUT
	select SOC_NRF52832_QFAA
```

## bl652_breakout/Kconfig.defconfig
```kconfig
# Copyright (c) 2024 thedjnK
# SPDX-License-Identifier: Apache-2.0

config BT_CTLR
	default BT if BOARD_BL652_BREAKOUT
```

## bl652_breakout/board.yml
```yaml
board:
  name: bl652_breakout
  full_name: BL652 breakout board
  vendor: ogatatsu
  socs:
    - name: nrf52832
```

## bt510_fridge/board.yml
```yaml
board:
  name: bt510_fridge
  full_name: BT510 in fridge
  vendor: thedjnK
  socs:
    - name: nrf52840
```

## bt710/Kconfig.bt710
```kconfig
# BT710 board configuration

# Copyright (c) 2020 Laird Connectivity
# Copyright (c) 2024 Jamie M.
# SPDX-License-Identifier: Apache-2.0

config BOARD_BT710
	select SOC_NRF52833_QIAA
```

## bt710/Kconfig.defconfig
```kconfig
# BT710 Sensor configuration

# Copyright (c) 2020 Laird Connectivity
# Copyright (c) 2024 Jamie M.
# SPDX-License-Identifier: Apache-2.0

if BOARD_BT710

config IEEE802154_NRF5
	default y
	depends on IEEE802154

config BT_CTLR
	default BT

config SPI_NOR_FLASH_LAYOUT_PAGE_SIZE
	default 4096 if SPI_NOR

config SPI_NOR_IDLE_IN_DPD
	default y if SPI_NOR

endif # BOARD_BT710
```

## bt710/board.yml
```yaml
board:
  name: bt710
  full_name: BT710
  vendor: thedjnK
  socs:
    - name: nrf52833
```

## bt710/bt710_nrf52833_defconfig
```kconfig
# SPDX-License-Identifier: Apache-2.0

# Enable MPU
CONFIG_ARM_MPU=y

# Enable GPIO
CONFIG_GPIO=y

# Enable PWM 
#CONFIG_PWM=y

# Enable accelerometer
CONFIG_I2C=y
CONFIG_SENSOR=y
CONFIG_LIS2DH=y
CONFIG_LIS2DH_OPER_MODE_LOW_POWER=y
CONFIG_LIS2DH_ODR_1=y
CONFIG_LIS2DH_ACCEL_RANGE_2G=y
CONFIG_LIS2DH_TRIGGER_NONE=y
CONFIG_PM_DEVICE=y

# Enable flash
CONFIG_SPI=y
CONFIG_FLASH=y
CONFIG_SPI_NOR=y

# 32KHz clock source
CONFIG_CLOCK_CONTROL_NRF_K32SRC_XTAL=y
CONFIG_CLOCK_CONTROL_NRF_K32SRC_250PPM=y
```

## rm1xx/Kconfig.defconfig
```kconfig
# Copyright (c) 2024 Jamie M.
# SPDX-License-Identifier: Apache-2.0

if BOARD_RM1XX

config BT_CTLR
	default BT

config SPI_NOR_CS_WAIT_DELAY
	default 40

endif # BOARD_RM1XX
```

## rm1xx/Kconfig.rm1xx
```kconfig
# Copyright (c) 2024 Jamie M.
# SPDX-License-Identifier: Apache-2.0

config BOARD_RM1XX
	select SOC_NRF51822_QFAC
```

## rm1xx/board.yml
```yaml
board:
  name: rm1xx
  full_name: RM1xx module
  vendor: lairdconnect
  socs:
  - name: nrf51822
```

## rs1xx/Kconfig.defconfig
```kconfig
# Copyright (c) 2024 Jamie M.
# SPDX-License-Identifier: Apache-2.0

if BOARD_RS1XX

config BT_CTLR
	default BT

config SPI_NOR_CS_WAIT_DELAY
	default 40

config SPI_NOR_FLASH_LAYOUT_PAGE_SIZE
	default 4096

endif # BOARD_RS1XX
```

## rs1xx/Kconfig.rs1xx
```kconfig
# Copyright (c) 2024 Jamie M.
# SPDX-License-Identifier: Apache-2.0

config BOARD_RS1XX
	select SOC_NRF51822_QFAC
```

## rs1xx/board.yml
```yaml
board:
  name: rs1xx
  full_name: RS1xx sensor
  vendor: lairdconnect
  socs:
  - name: nrf51822
```
