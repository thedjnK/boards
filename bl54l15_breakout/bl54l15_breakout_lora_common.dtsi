/*
 * Copyright (c) 2025 Jamie M.
 *
 * All right reserved. This code is NOT apache or FOSS/copyleft licensed.
 */

#include <zephyr/dt-bindings/lora/sx126x.h>

/* NVM (RRAM) configuration */
#define NVM_SIZE DT_SIZE_K(1524)
#define NVM_SECTOR_SIZE 0x800

/* CPUFLPR code will be part of CPUAPP partition and is the maximum size the image can be inside
 * of this
 */
#define NVM_CPUAPP_SIZE DT_SIZE_K(1524)
#define NVM_CPUFLPR_SIZE DT_SIZE_K(120)

/* Offset inside of CPUAPP image to place CPUFLPR image */
#define NVM_CPUFLPR_OFFSET (NVM_SECTOR_SIZE * 2)

#define NVM_CPUAPP_START 0x0
#define NVM_CPUFLPR_START (NVM_CPUAPP_START + NVM_CPUFLPR_OFFSET)

#define NVM_USAGE_TOTAL NVM_CPUAPP_SIZE

/* RAM configuration */
#define RAM_SIZE DT_SIZE_K(256)

#define RAM_CPUAPP_SIZE DT_SIZE_K(127)
#define RAM_CPUFLPR_SIZE DT_SIZE_K(127)
#define RAM_IPC_CPUAPP_TX_SIZE 0x400
#define RAM_IPC_CPUAPP_RX_SIZE 0x400
#define RAM_IPC_BLOCK_SIZE 32

#define RAM_CPUAPP_START 0x20000000
#define RAM_CPUFLPR_START (RAM_CPUAPP_START + RAM_CPUAPP_SIZE)
#define RAM_IPC_CPUAPP_TX_START (RAM_CPUFLPR_START + RAM_CPUFLPR_SIZE)
#define RAM_IPC_CPUAPP_RX_START (RAM_IPC_CPUAPP_TX_START + RAM_IPC_CPUAPP_TX_SIZE)

#define RAM_USAGE_TOTAL (RAM_IPC_CPUAPP_RX_START + RAM_IPC_CPUAPP_RX_SIZE - RAM_CPUAPP_START)

/* Validation */
#if RAM_USAGE_TOTAL > RAM_SIZE
#error "Invalid RAM setup: RAM usage too large"
#endif

#if (RAM_IPC_CPUAPP_TX_START % RAM_IPC_BLOCK_SIZE) != 0
#error "Invalid RAM setup: TX IPC block start not aligned"
#endif

#if (RAM_IPC_CPUAPP_TX_SIZE % RAM_IPC_BLOCK_SIZE) != 0
#error "Invalid RAM setup: TX IPC block size not aligned"
#endif

#if (RAM_IPC_CPUAPP_RX_START % RAM_IPC_BLOCK_SIZE) != 0
#error "Invalid RAM setup: RX IPC block start not aligned"
#endif

#if (RAM_IPC_CPUAPP_RX_SIZE % RAM_IPC_BLOCK_SIZE) != 0
#error "Invalid RAM setup: RX IPC block size not aligned"
#endif

#if NVM_USAGE_TOTAL > NVM_SIZE
#error "Invalid NVM setup: NVM usage too large"
#endif

#if (NVM_CPUAPP_SIZE % NVM_SECTOR_SIZE) != 0
#error "Invalid NVM setup: cpuapp NVM size not sector aligned"
#endif

#if (NVM_CPUFLPR_SIZE % NVM_SECTOR_SIZE) != 0
#error "Invalid NVM setup: cpuflpr NVM size not sector aligned"
#endif

#if (NVM_CPUAPP_START % NVM_SECTOR_SIZE) != 0
#error "Invalid NVM setup: cpuapp NVM start not sector aligned"
#endif

#if (NVM_CPUFLPR_START % NVM_SECTOR_SIZE) != 0
#error "Invalid NVM setup: cpuflpr NVM start not sector aligned"
#endif

#if NVM_USAGE_TOTAL < NVM_SIZE
#warning "Non-optimal NVM setup: NVM usage less than NVM size"
#endif

/* IPC */
#define INTERRUPT_IPC_CPUAPP_TX 21
#define INTERRUPT_IPC_CPUAPP_RX 20

/* CPUAPP configuration */
#define NVM_CPUAPP_PARTITION_MCUBOOT_SIZE DT_SIZE_K(48)
#define NVM_CPUAPP_PARTITION_SLOT0_SIZE DT_SIZE_K(720)
#define NVM_CPUAPP_PARTITION_SLOT1_SIZE DT_SIZE_K(720)
#define NVM_CPUAPP_PARTITION_SETTINGS_SIZE DT_SIZE_K(36)

#define NVM_CPUAPP_PARTITION_MCUBOOT_START NVM_CPUAPP_START
#define NVM_CPUAPP_PARTITION_SLOT0_START (NVM_CPUAPP_PARTITION_MCUBOOT_START + NVM_CPUAPP_PARTITION_MCUBOOT_SIZE)
#define NVM_CPUAPP_PARTITION_SLOT1_START (NVM_CPUAPP_PARTITION_SLOT0_START + NVM_CPUAPP_PARTITION_SLOT0_SIZE)
#define NVM_CPUAPP_PARTITION_SETTINGS_START (NVM_CPUAPP_PARTITION_SLOT1_START + NVM_CPUAPP_PARTITION_SLOT1_SIZE)

#define NVM_CPUAPP_USAGE_TOTAL (NVM_CPUAPP_PARTITION_SETTINGS_START + NVM_CPUAPP_PARTITION_SETTINGS_SIZE - NVM_CPUAPP_START)

#if (NVM_CPUAPP_PARTITION_MCUBOOT_SIZE % NVM_SECTOR_SIZE) != 0
#error "Invalid NVM setup: cpuapp NVM MCUboot size not sector aligned"
#endif

#if (NVM_CPUAPP_PARTITION_SLOT0_SIZE % NVM_SECTOR_SIZE) != 0
#error "Invalid NVM setup: cpuapp NVM slot0 size not sector aligned"
#endif

#if (NVM_CPUAPP_PARTITION_SLOT1_SIZE % NVM_SECTOR_SIZE) != 0
#error "Invalid NVM setup: cpuapp NVM slot1 size not sector aligned"
#endif

#if (NVM_CPUAPP_PARTITION_SETTINGS_SIZE % NVM_SECTOR_SIZE) != 0
#error "Invalid NVM setup: cpuapp NVM settings size not sector aligned"
#endif

#if (NVM_CPUAPP_PARTITION_SLOT0_START % NVM_SECTOR_SIZE) != 0
#error "Invalid NVM setup: cpuapp NVM slot0 start not sector aligned"
#endif

#if (NVM_CPUAPP_PARTITION_SLOT1_START % NVM_SECTOR_SIZE) != 0
#error "Invalid NVM setup: cpuapp NVM slot1 start not sector aligned"
#endif

#if (NVM_CPUAPP_PARTITION_SETTINGS_START % NVM_SECTOR_SIZE) != 0
#error "Invalid NVM setup: cpuapp NVM settings start not sector aligned"
#endif

#if NVM_CPUAPP_USAGE_TOTAL > NVM_CPUAPP_SIZE
#error "Invalid NVM setup: cpuapp NVM usage more than NVM size"
#endif

#if NVM_CPUAPP_USAGE_TOTAL < NVM_CPUAPP_SIZE
#warning "Non-optimal NVM setup: cpuapp NVM usage less than NVM size"
#endif

/ {
	aliases {
		lora0 = &sx1262;
	};
};

&spi00 {
	cs-gpios = <&gpio2 6 GPIO_ACTIVE_LOW>;
	pinctrl-0 = <&spi00_default>;
	pinctrl-1 = <&spi00_sleep>;
	pinctrl-names = "default", "sleep";

	sx1262: sx1262@0 {
		compatible = "semtech,sx1262";
		reg = <0>;
		spi-max-frequency = <DT_FREQ_M(8)>;
		reset-gpios = <&gpio2 3 GPIO_ACTIVE_LOW>;
		busy-gpios = <&gpio2 8 GPIO_ACTIVE_HIGH>;
		dio1-gpios = <&gpio1 10 GPIO_ACTIVE_HIGH>;
		dio2-tx-enable;
		dio3-tcxo-voltage = <SX126X_DIO3_TCXO_1V7>;
		rx-enable-gpios = <&gpio2 10 GPIO_ACTIVE_HIGH>;
		tcxo-power-startup-delay-ms = <6>;
	};
};
